/* Copyright (c) 2013, The Linux Foundation. All rights reserved.
 *
 * This program is free software; you can redistribute it and/or modify
 * it under the terms of the GNU General Public License version 2 and
 * only version 2 as published by the Free Software Foundation.
 *
 * This program is distributed in the hope that it will be useful,
 * but WITHOUT ANY WARRANTY; without even the implied warranty of
 * MERCHANTABILITY or FITNESS FOR A PARTICULAR PURPOSE.  See the
 * GNU General Public License for more details.
 */

/*---------------------------------------------------------------------------
 * This file is autogenerated file using gcdb parser. Please do not edit it.
 * Update input XML file to add a new entry or update variable in this file
 * VERSION = "1.0"
 *---------------------------------------------------------------------------*/
&mdss_mdp {
	dsi_lead_hsd_rm68172_fwvga_vid: qcom,zte-lead-rm68172-hsd-fwvga-video {
		qcom,mdss-dsi-panel-name = "zteLEAD(RM68172)HSD_480*854_4P5Inch";
		qcom,mdss-pan-physical-height-dimension = <99>;		
		qcom,mdss-pan-physical-width-dimension = <56>;			
		qcom,cont-splash-enabled;
		qcom,mdss-dsi-panel-controller = <&mdss_dsi0>;
		qcom,mdss-dsi-panel-type = "dsi_video_mode";
		qcom,mdss-dsi-panel-destination = "display_1";
		qcom,mdss-dsi-panel-framerate = <60>;
		qcom,mdss-dsi-virtual-channel-id = <0>;
		qcom,mdss-dsi-stream = <0>;
		qcom,mdss-dsi-panel-width = <480>;
		qcom,mdss-dsi-panel-height = <854>;
		qcom,mdss-dsi-h-front-porch = <44>;
		qcom,mdss-dsi-h-back-porch = <42>;
		qcom,mdss-dsi-h-pulse-width = <8>;
		qcom,mdss-dsi-h-sync-skew = <0>;
		qcom,mdss-dsi-v-front-porch = <14>;
		qcom,mdss-dsi-v-pulse-width = <2>;
		qcom,mdss-dsi-v-back-porch = <14>;
		qcom,mdss-dsi-h-left-border = <0>;
		qcom,mdss-dsi-h-right-border = <0>;
		qcom,mdss-dsi-v-top-border = <0>;
		qcom,mdss-dsi-v-bottom-border = <0>;
		qcom,mdss-dsi-bpp = <24>;
		qcom,mdss-dsi-color-order = <0>;
		qcom,mdss-dsi-underflow-color = <0xff>;
		qcom,mdss-dsi-border-color = <0>;
		qcom,mdss-dsi-on-command= [

29 01 00 00 00 00 06 F0 55 AA 52 08 02
29 01 00 00 00 00 03 F6 60 40
29 01 00 00 00 00 05 FE 01 80 09 09
29 01 00 00 00 00 06 F0 55 AA 52 08 01
29 01 00 00 00 00 02 B0 0D
29 01 00 00 00 00 02 B1 0D
29 01 00 00 00 00 02 B5 08
29 01 00 00 00 00 02 B6 34
29 01 00 00 00 00 02 B7 34
29 01 00 00 00 00 02 B8 24
29 01 00 00 00 00 02 B9 34
29 01 00 00 00 00 02 BA 14
29 01 00 00 00 00 04 BC 00 78 00
29 01 00 00 00 00 04 BD 00 78 00
29 01 00 00 00 00 03 BE 00 5D        
29 01 00 00 00 00 35 D1 00 00 00 0A 00 29 00 4A 00 65 00 93 00 B7 00 EF 01 18 01 54 01 81 01 C3 01 F7 01 F9 02 26 02 53 02 6D 02 8B 02 9D 02 B4 02 C4 02 D9 02 E9 03 00 03 35 03 FF

29 01 00 00 00 00 35 D2 00 00 00 0A 00 29 00 4A 00 65 00 93 00 B7 00 EF 01 18 01 54 01 81 01 C3 01 F7 01 F9 02 26 02 53 02 6D 02 8B 02 9D 02 B4 02 C4 02 D9 02 E9 03 00 03 35 03 FF

29 01 00 00 00 00 35 D3 00 00 00 0A 00 29 00 4A 00 65 00 93 00 B7 00 EF 01 18 01 54 01 81 01 C3 01 F7 01 F9 02 26 02 53 02 6D 02 8B 02 9D 02 B4 02 C4 02 D9 02 E9 03 00 03 35 03 FF

29 01 00 00 00 00 35 D4 00 00 00 0A 00 29 00 4A 00 65 00 93 00 B7 00 EF 01 18 01 54 01 81 01 C3 01 F7 01 F9 02 26 02 53 02 6D 02 8B 02 9D 02 B4 02 C4 02 D9 02 E9 03 00 03 35 03 FF

29 01 00 00 00 00 35 D5 00 00 00 0A 00 29 00 4A 00 65 00 93 00 B7 00 EF 01 18 01 54 01 81 01 C3 01 F7 01 F9 02 26 02 53 02 6D 02 8B 02 9D 02 B4 02 C4 02 D9 02 E9 03 00 03 35 03 FF

29 01 00 00 00 00 35 D6 00 00 00 0A 00 29 00 4A 00 65 00 93 00 B7 00 EF 01 18 01 54 01 81 01 C3 01 F7 01 F9 02 26 02 53 02 6D 02 8B 02 9D 02 B4 02 C4 02 D9 02 E9 03 00 03 35 03 FF

29 01 00 00 00 00 06 F0 55 AA 52 08 00
29 01 00 00 00 00 04 B0 00 10 0A
29 01 00 00 00 00 02 B1 78
29 01 00 00 00 00 02 B4 10
29 01 00 00 00 00 02 B5 6B
29 01 00 00 00 00 02 B6 35
29 01 00 00 00 00 05 B8 01 03 03 03
29 01 00 00 00 00 02 BA 01
29 01 00 00 00 00 02 BC 02  //00列翻转

29 01 00 00 00 00 02 53 24     //开启PWM功能
29 01 00 00 00 00 02 51 80     //PWM占空比调整  参数越大占空比越大，最大0xFF,最小0x00
29 01 00 00 00 00 03 E0 00 01  //调整PWM频率，0x00 01--27.34KHZ

29 01 00 00 00 00 06 F0 55 AA 52 08 03
29 01 00 00 00 00 08 B0 05 15 F5 55 2C 00 30
29 01 00 00 00 00 0a B2 F9 FA FB FC F0 2C 00 C5 08
29 01 00 00 00 00 07 B3 5B 00 F9 57 57 0C
29 01 00 00 00 00 0c B4 FD FE FF 00 FC 40 05 08 2C 00 00
29 01 00 00 00 00 0c B5 00 44 FD 83 58 59 5A 5B 33 33 E4
29 01 00 00 00 00 08 B6 F8 32 00 00 0A 80 00
29 01 00 00 00 00 09 B7 01 01 01 01 01 01 00 00
29 01 00 00 00 00 04 B8 12 00 00
29 01 00 00 00 00 02 B9 90
29 01 00 00 00 00 11 BA 54 13 B9 FD 13 FF FF FF FF FF FF 20 CE 8A 20 45
29 01 00 00 00 00 11 BB 45 13 CE 8A 20 FF FF FF FF FF FF 13 B9 FD 20 54
29 01 00 00 00 00 05 BC F0 3F FC 0F
29 01 00 00 00 00 05 BD F0 3F FC 0F
29 01 00 00 00 00 05 C0 00 01 FA 00
29 01 00 00 00 00 06 F0 55 AA 52 08 00
29 01 00 00 00 00 03 B0 00 10
29 01 00 00 00 00 02 35 00

05 01 00 00 78 00 02 11 00 
05 01 00 00 05 00 02 29 00
]; 

		qcom,mdss-dsi-off-command = [05 01 00 00 32 00 02 28 00
					05 01 00 00 78 00 02 10 00];
		qcom,mdss-dsi-on-command-state = "dsi_lp_mode";
		qcom,mdss-dsi-off-command-state = "dsi_hs_mode";
		qcom,mdss-dsi-h-sync-pulse = <1>;
		//qcom,mdss-dsi-traffic-mode = "burst_mode";
		qcom,mdss-dsi-lane-map = "lane_map_0123";
		qcom,mdss-dsi-bllp-eof-power-mode;
		qcom,mdss-dsi-bllp-power-mode;
		qcom,mdss-dsi-lane-0-state;
		qcom,mdss-dsi-lane-1-state;
		/*add for cmd mode start 20140410*/
              qcom,mdss-dsi-te-pin-select = <1>;
               qcom,mdss-dsi-wr-mem-start = <0x2c>;
               qcom,mdss-dsi-te-dcs-command = <1>;
               qcom,mdss-dsi-te-check-enable;
               qcom,mdss-dsi-te-using-te-pin;
               /*add for cmd mode end 20140410*/
		qcom,mdss-dsi-panel-timings = [6F 16 0E 00 38 3C 12 1A 13 03 04 00];
		qcom,mdss-dsi-t-clk-post = <0x04>;
		qcom,mdss-dsi-t-clk-pre = <0x18>;
		qcom,mdss-dsi-bl-min-level = <1>;
		qcom,mdss-dsi-bl-max-level = <255>;
		qcom,mdss-dsi-dma-trigger = "trigger_sw";
		qcom,mdss-dsi-mdp-trigger = "none";
		//qcom,mdss-dsi-bl-cmd-gpio =  <&msm_gpio 97 0>;
		qcom,mdss-dsi-bl-pmic-control-type = "bl_ctrl_dcs";
		qcom,mdss-dsi-reset-sequence = <1 20>, <0 20>, <1 20>;

	};
};               
