/* Copyright (c) 2012, Code Aurora Forum. All rights reserved.
 *
 * This program is free software; you can redistribute it and/or modify
 * it under the terms of the GNU General Public License version 2 and
 * only version 2 as published by the Free Software Foundation.
 *
 * This program is distributed in the hope that it will be useful,
 * but WITHOUT ANY WARRANTY; without even the implied warranty of
 * MERCHANTABILITY or FITNESS FOR A PARTICULAR PURPOSE.  See the
 * GNU General Public License for more details.
 */

 /*---------------------------------------------------------------------------
 * This file is autogenerated file using gcdb parser. Please do not edit it.
 * Update input XML file to add a new entry or update variable in this file
 * VERSION = "1.0"
 *file name:dsi-panel-zte-tianma_s6d7aa6_tm-5p5-720p-video.dtsi
 *author   :created by pingzhenghai at 20160314
 *when    			   who(by)   			who(from) 			  why
 *2016.03.14	                  pingzhenghai	  	huwenlong		         create
 *---------------------------------------------------------------------------*/
&mdss_mdp {
    dsi_tianma_s6d7aa6_tm_5p5_720p_video: qcom,mdss_dsi_tianma_s6d7aa6_tm_5p5_720p_video{         
		qcom,mdss-dsi-panel-name =  "zteTIANMA(S6D7AA6)TM_720*1280_5.5Inch"; 	
		qcom,cont-splash-enabled; 
		qcom,mdss-pan-physical-height-dimension = <121>;
		qcom,mdss-pan-physical-width-dimension = <68>;
 		qcom,mdss-dsi-panel-controller = <&mdss_dsi0>;
		qcom,mdss-dsi-panel-type = "dsi_video_mode";
		qcom,mdss-dsi-panel-destination = "display_1";
		qcom,mdss-dsi-panel-framerate = <60>;
		qcom,mdss-dsi-virtual-channel-id = <0>;
		qcom,mdss-dsi-stream = <0>;
		qcom,mdss-dsi-panel-width = <720>;
		qcom,mdss-dsi-panel-height = <1280>;
		qcom,mdss-dsi-h-front-porch = <16>;//mipi clk=425.09,xiaoyu and maojianfeng	
		qcom,mdss-dsi-h-back-porch = <48>;
		qcom,mdss-dsi-h-pulse-width =  <16>;
		qcom,mdss-dsi-h-sync-skew = <0>;
		qcom,mdss-dsi-v-front-porch = <16>;
		qcom,mdss-dsi-v-back-porch = <12>;		
		qcom,mdss-dsi-v-pulse-width = <4>;
		qcom,mdss-dsi-h-left-border = <0>;
		qcom,mdss-dsi-h-right-border = <0>;
		qcom,mdss-dsi-v-top-border = <0>;
		qcom,mdss-dsi-v-bottom-border = <0>;
		qcom,mdss-dsi-bpp = <24>;
		qcom,mdss-dsi-color-order = <0>;
		qcom,mdss-dsi-underflow-color = <0xff>;
		qcom,mdss-dsi-border-color = <0>;
		
		qcom,mdss-dsi-off-command = [
		        05 01 00 00 32 00 02 28 00
		        05 01 00 00 78 00 02 10 00
		];
		qcom,mdss-dsi-on-command-state = "dsi_lp_mode";	
		qcom,mdss-dsi-off-command-state = "dsi_hs_mode";	
		qcom,mdss-dsi-h-sync-pulse = <1>;		
		qcom,mdss-dsi-traffic-mode = "burst_mode";//default 0	
		qcom,mdss-dsi-lane-map = "lane_map_0123";		
		qcom,mdss-dsi-bllp-eof-power-mode;		
		qcom,mdss-dsi-bllp-power-mode;		
		qcom,mdss-dsi-lane-0-state;		
		qcom,mdss-dsi-lane-1-state;	
		qcom,mdss-dsi-lane-2-state;	
		qcom,mdss-dsi-lane-3-state;	
		qcom,mdss-dsi-lp11-init;		
		qcom,mdss-dsi-panel-timings = [75 18 10 00 3a 3c 14 1a 13 03 04 a0];		
		qcom,mdss-dsi-t-clk-post = <0x04>;	
		qcom,mdss-dsi-t-clk-pre = <0x1a>;		
		qcom,mdss-dsi-bl-min-level = <1>;	
		qcom,mdss-dsi-bl-max-level = <255>;	
		qcom,mdss-dsi-dma-trigger = <0x04>;	
		qcom,mdss-dsi-mdp-trigger = <0x0>;	
		qcom,mdss-dsi-bl-pmic-control-type = "bl_ctrl_dcs";	
		//qcom,mdss-dsi-bl-cmd-gpio = <&msmgpio 1 0>;	
		qcom,mdss-dsi-reset-sequence = <1 2>, <0 2>, <1 20>;
		qcom,mdss-dsi-on-command= [
		                39 01 00 00 00 00 03 b9 00 00 
                                39 01 00 00 00 00 03 bb 09 00
                                39 01 00 00 00 00 03 b9 01 00
				39 01 00 00 00 00 03 b7 10 05
				39 01 00 00 00 00 03 bc 02 00
				39 01 00 00 00 00 03 bf 51 ff
				39 01 00 00 00 00 03 bc 02 00
				39 01 00 00 00 00 03 bf 53 24
				39 01 00 00 00 00 03 bc 02 00
				39 01 00 00 00 00 03 bf 55 00
				39 01 00 00 00 00 03 bc 01 00
				39 01 00 00 00 00 02 bf 11
				39 01 00 00 00 00 03 bc 01 00
				39 01 00 00 00 00 02 bf 29 
				39 01 00 00 00 00 03 bc 02 00
				39 01 00 00 00 00 03 bf 35 00
				39 01 00 00 00 00 03 b9 00 00
				39 01 00 00 00 00 03 b7 59 06
				39 01 00 00 00 00 03 b9 01 00
				39 01 00 00 00 00 03 bc 03 00
				39 01 00 00 00 00 03 bf f0 5a
				39 01 00 00 00 00 04 bf f0 5a 5a
				39 01 00 00 00 00 03 bc 03 00
				39 01 00 00 00 00 04 bf f1 5a 5a
				39 01 00 00 00 00 03 bc 03 00
				39 00 00 00 00 00 02 51 ff //backlight
				39 00 00 00 00 00 02 53 2c
				
				05 01 00 00 78 00 02 11 00 //suspend and resume
				05 01 00 00 0a 00 02 29 00				
		];
    };
};
