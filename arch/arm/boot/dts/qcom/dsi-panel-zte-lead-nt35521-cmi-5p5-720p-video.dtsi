/* Copyright (c) 2012, Code Aurora Forum. All rights reserved.
 *
 * This program is free software; you can redistribute it and/or modify
 * it under the terms of the GNU General Public License version 2 and
 * only version 2 as published by the Free Software Foundation.
 *
 * This program is distributed in the hope that it will be useful,
 * but WITHOUT ANY WARRANTY; without even the implied warranty of
 * MERCHANTABILITY or FITNESS FOR A PARTICULAR PURPOSE.  See the
 * GNU General Public License for more details.
 */

 /*---------------------------------------------------------------------------
 * This file is autogenerated file using gcdb parser. Please do not edit it.
 * Update input XML file to add a new entry or update variable in this file
 * VERSION = "1.0"
 *file name:dsi-panel-zte-lead-nt35521-cpt-5p5-720p-video.h
 *author   :created by tangzhengbo at 20150109
 *when    			   who(by)   			who(from) 			why
 *2015.01.09	       tangzhengbo	  	        hanwenjun		     create
 *---------------------------------------------------------------------------*/
&mdss_mdp {

        dsi_nt35521_cpt_720p_vid: qcom,mdss_dsi_lead_nt35521_cmi_5p5_720p_video{
        	qcom,mdss-dsi-panel-name =  "zteLEAD(NT35521S)CMI_720*1280_5.5Inch";             
		qcom,cont-splash-enabled; 		
 		qcom,mdss-dsi-panel-controller = <&mdss_dsi0>;
		qcom,mdss-dsi-panel-type = "dsi_video_mode";
		qcom,mdss-dsi-panel-destination = "display_1";
		qcom,mdss-dsi-panel-framerate = <60>;
		qcom,mdss-dsi-virtual-channel-id = <0>;
		qcom,mdss-dsi-stream = <0>;
		qcom,mdss-dsi-panel-width = <720>;
		qcom,mdss-dsi-panel-height = <1280>;
		qcom,mdss-dsi-h-front-porch = <40>;//mipi clk=380M,confirmed with vendor,for P890A56 on 20160412,wuqingfeng,	
		qcom,mdss-dsi-h-back-porch = <40>;
		qcom,mdss-dsi-h-pulse-width =  <6>;
		qcom,mdss-dsi-h-sync-skew = <0>;
		qcom,mdss-dsi-v-front-porch = <16>;
		qcom,mdss-dsi-v-back-porch = <14>;		
		qcom,mdss-dsi-v-pulse-width = <2>;
		qcom,mdss-dsi-h-left-border = <0>;
		qcom,mdss-dsi-h-right-border = <0>;
		qcom,mdss-dsi-v-top-border = <0>;
		qcom,mdss-dsi-v-bottom-border = <0>;
		qcom,mdss-dsi-bpp = <24>;
		qcom,mdss-dsi-color-order = <0>;
		qcom,mdss-dsi-underflow-color = <0xff>;
		qcom,mdss-dsi-border-color = <0>;
		qcom,mdss-dsi-h-sync-pulse = <0>;
		qcom,mdss-dsi-traffic-mode = <1>;		
		qcom,mdss-dsi-lane-map = "lane_map_0123";
		qcom,mdss-dsi-bllp-eof-power-mode;
		qcom,mdss-dsi-bllp-power-mode;
		qcom,suspend-ulps-enabled;
		qcom,mdss-dsi-lane-0-state;
		qcom,mdss-dsi-lane-1-state;
		qcom,mdss-dsi-lane-2-state;
		qcom,mdss-dsi-lane-3-state;
		qcom,mdss-dsi-lp11-init;
		qcom,mdss-dsi-panel-timings =[75 18 10 00 3a 3e 14 1e 13 03 04 a0];
		qcom,mdss-dsi-t-clk-post = <0x04>;
		qcom,mdss-dsi-t-clk-pre = <0x19>;
		qcom,mdss-dsi-bl-min-level = <1>;
		qcom,mdss-dsi-bl-max-level = <255>;
		qcom,mdss-dsi-dma-trigger = <0x04>;
		qcom,mdss-dsi-mdp-trigger = <0x0>;
		qcom,mdss-dsi-bl-pmic-control-type = "bl_ctrl_dcs";
		qcom,mdss-dsi-panel-status-command = [06 01 00 01 05 00 02 0A 08]; //read command to be sent
		qcom,mdss-dsi-panel-status-command-state = "dsi_lp_mode"; //link state for the read command
		qcom,mdss-dsi-panel-status-check-mode = "reg_read"; //register read approach
		qcom,mdss-dsi-panel-status-value = <0x9c>; //expected success value if the panel is in good state
		qcom,esd-check-enabled; //enables ESD
		//qcom,mdss-dsi-bl-cmd-gpio = <&msmgpio 33 0>;
		qcom,mdss-dsi-reset-sequence = <1 5>, <0 5>, <1 20>;
		qcom,mdss-pan-physical-width-dimension = <68>;
		qcom,mdss-pan-physical-height-dimension = <121>;
                qcom,mdss-dsi-on-command= [
                     39 00 00 00 00 00 05 FF AA 55 A5 80
                     39 00 00 00 00 00 03 6F 11 00 
                     39 00 00 00 00 00 03 F7 20 00 
                     39 00 00 00 00 00 02 6F 06    
                     39 00 00 00 00 00 02 F7 A0    
                     39 00 00 00 00 00 02 6F 19    
                     39 00 00 00 00 00 02 F7 12    
                     39 00 00 00 00 00 06 F0 55 AA 52 08 00 
                     39 00 00 00 00 00 02 C8 80             
                     39 00 00 00 00 00 03 B1 6C 21          
                     39 00 00 00 00 00 02 B6 0F             
                     39 00 00 00 00 00 02 6F 02             
                     39 00 00 00 00 00 02 B8 08             
                     39 00 00 00 00 00 03 BB 74 44          
                     39 00 00 00 00 00 03 BC 00 00          
                     39 00 00 00 00 00 06 BD 02 B0 1e 1e 00 	
                     39 00 00 00 00 00 06 F0 55 AA 52 08 01 
                     39 00 00 00 00 00 03 B0 05 05          
                     39 00 00 00 00 00 03 B1 05 05          
                     39 00 00 00 00 00 03 BC 70 00          
                     39 00 00 00 00 00 03 BD 70 00          
                     39 00 00 00 00 00 02 CA 00             
                     39 00 00 00 00 00 02 C0 04             
                     39 00 00 00 00 00 02 BE 40 	           
                     39 00 00 00 00 00 03 B9 46 46          
                     39 00 00 00 00 00 03 B3 2D 2D          
                     39 00 00 00 00 00 03 BA 25 25          
                     39 00 00 00 00 00 03 B4 19 19          
                     39 00 00 00 00 00 06 F0 55 AA 52 08 02 
                     39 00 00 00 00 00 02 EE 01             
                     39 00 00 00 00 00 02 EE 02             
                     39 00 00 00 00 00 11 B0 00 6E 00 82 00 A6 00 BD 00 CA 00 E9 01 05 01 31
                     39 00 00 00 00 00 11 B1 01 53 01 8A 01 B2 01 F7 02 31 02 33 02 67 02 9C
                     39 00 00 00 00 00 11 B2 02 BC 02 EC 03 0B 03 32 03 4B 03 6E 03 84 03 A0
                     39 00 00 00 00 00 05 B3 03 BF 03 D3                                  
                     39 00 00 00 00 00 11 BC 00 15 00 26 00 45 00 63 00 83 00 AF 00 D1 01 02
                     39 00 00 00 00 00 11 BD 01 2C 01 70 01 A0 01 EE 02 27 02 29 02 5C 02 9B
                     39 00 00 00 00 00 11 BE 02 C0 02 F4 03 16 03 40 03 5B 03 80 03 96 03 AF
                     39 00 00 00 00 00 05 BF 03 C5 03 D3    
                     39 00 00 00 00 00 06 F0 55 AA 52 08 06 
                     39 00 00 00 00 00 03 B0 29 2A          
                     39 00 00 00 00 00 03 B1 10 12          
                     39 00 00 00 00 00 03 B2 14 16          
                     39 00 00 00 00 00 03 B3 18 1A          
                     39 00 00 00 00 00 03 B4 08 0A          
                     39 00 00 00 00 00 03 B5 2E 2E          
                     39 00 00 00 00 00 03 B6 2E 2E          
                     39 00 00 00 00 00 03 B7 2E 2E          
                     39 00 00 00 00 00 03 B8 2E 00          
                     39 00 00 00 00 00 03 B9 2E 2E          
                     39 00 00 00 00 00 03 BA 2E 2E          
                     39 00 00 00 00 00 03 BB 01 2E          
                     39 00 00 00 00 00 03 BC 2E 2E          
                     39 00 00 00 00 00 03 BD 2E 2E          
                     39 00 00 00 00 00 03 BE 2E 2E          
                     39 00 00 00 00 00 03 BF 0B 09          
                     39 00 00 00 00 00 03 C0 1B 19          
                     39 00 00 00 00 00 03 C1 17 15          
                     39 00 00 00 00 00 03 C2 13 11          
                     39 00 00 00 00 00 03 C3 2A 29          
                     39 00 00 00 00 00 03 E5 2E 2E          
                     39 00 00 00 00 00 03 C4 29 2A          
                     39 00 00 00 00 00 03 C5 1B 19          
                     39 00 00 00 00 00 03 C6 17 15          
                     39 00 00 00 00 00 03 C7 13 11          
                     39 00 00 00 00 00 03 C8 01 0B          
                     39 00 00 00 00 00 03 C9 2E 2E          
                     39 00 00 00 00 00 03 CA 2E 2E          
                     39 00 00 00 00 00 03 CB 2E 2E          
                     39 00 00 00 00 00 03 CC 2E 09          
                     39 00 00 00 00 00 03 CD 2E 2E          
                     39 00 00 00 00 00 03 CE 2E 2E          
                     39 00 00 00 00 00 03 CF 08 2E          
                     39 00 00 00 00 00 03 D0 2E 2E          
                     39 00 00 00 00 00 03 D1 2E 2E          
                     39 00 00 00 00 00 03 D2 2E 2E          
                     39 00 00 00 00 00 03 D3 0A 00          
                     39 00 00 00 00 00 03 D4 10 12          
                     39 00 00 00 00 00 03 D5 14 16          
                     39 00 00 00 00 00 03 D6 18 1A          
                     39 00 00 00 00 00 03 D7 2A 29          
                     39 00 00 00 00 00 03 E6 2E 2E          
                     39 00 00 00 00 00 06 D8 00 00 00 00 00 
                     39 00 00 00 00 00 06 D9 00 00 00 00 00 	
                     39 00 00 00 00 00 02 E7 00             
                     39 00 00 00 00 00 06 F0 55 AA 52 08 03 
                     39 00 00 00 00 00 03 B0 00 00          
                     39 00 00 00 00 00 03 B1 00 00          
                     39 00 00 00 00 00 06 B2 05 00 00 00 00 
                     39 00 00 00 00 00 06 B6 05 00 00 00 00 
                     39 00 00 00 00 00 06 B7 05 00 00 00 00 
                     39 00 00 00 00 00 06 BA 57 00 00 00 00 
                     39 00 00 00 00 00 06 BB 57 00 00 00 00 
                     39 00 00 00 00 00 05 C0 00 00 00 00    
                     39 00 00 00 00 00 05 C1 00 00 00 00    
                     39 00 00 00 00 00 02 C4 60             
                     39 00 00 00 00 00 02 C5 40             
                     39 00 00 00 00 00 06 F0 55 AA 52 08 05 
                     39 00 00 00 00 00 06 BD 03 01 03 03 03 
                     39 00 00 00 00 00 03 B0 17 06          
                     39 00 00 00 00 00 03 B1 17 06          
                     39 00 00 00 00 00 03 B2 17 06          
                     39 00 00 00 00 00 03 B3 17 06          
                     39 00 00 00 00 00 03 B4 17 06          
                     39 00 00 00 00 00 03 B5 17 06          
                     39 00 00 00 00 00 02 B8 00             
                     39 00 00 00 00 00 02 B9 00             
                     39 00 00 00 00 00 02 BA 00             
                     39 00 00 00 00 00 02 BB 02             
                     39 00 00 00 00 00 02 BC 00             
                     39 00 00 00 00 00 02 C0 07             
                     39 00 00 00 00 00 02 C4 80             
                     39 00 00 00 00 00 02 C5 A4             
                     39 00 00 00 00 00 03 C8 05 30          
                     39 00 00 00 00 00 03 C9 01 31          
                     39 00 00 00 00 00 04 CC 00 00 3C       
                     39 00 00 00 00 00 04 CD 00 00 3C       
                     39 00 00 00 00 00 06 D1 00 05 09 07 10 
                     39 00 00 00 00 00 06 D2 00 05 0E 07 10 
                     39 00 00 00 00 00 02 E5 06             
                     39 00 00 00 00 00 02 E6 06             
                     39 00 00 00 00 00 02 E7 06             
                     39 00 00 00 00 00 02 E8 06             
                     39 00 00 00 00 00 02 E9 06             
                     39 00 00 00 00 00 02 EA 06             
                     39 00 00 00 00 00 02 ED 30             
                     39 00 00 00 00 00 02 6F 11 	           
                     39 00 00 00 00 00 02 F3 01             
                     39 00 00 00 00 00 06 F0 55 AA 52 08 00 
                     39 00 00 00 00 00 03 D9 02 07    // LEDPWM 30.9KHz 
                     39 00 00 00 00 00 06 F0 55 AA 52 08 04 //LV      //modify crystal polarize 
                     39 00 00 00 00 00 05 EA 00 00 3F 7F  //LV 
		        39 00 00 00 00 00 05 FF AA 55 25 01 //LV DVDD
                     39 00 00 00 00 00 02 6F 1C                     
                     39 00 00 00 00 00 02 FA 01 
		        39 00 00 00 00 00 05 FF AA 55 25 00
		        39 00 00 00 00 00 02 62 01 
		        05 01 00 00 78 00 02 11 00 
		        05 01 00 00 0a 00 02 29 00				
				];				
                qcom,mdss-dsi-on-command-state = "dsi_lp_mode";
                qcom,mdss-dsi-off-command = [
                05 01 00 00 00 00 02 28 00
                05 01 00 00 78 00 02 10 00
                15 01 00 00 00 00 02 4f 01];
                qcom,mdss-dsi-off-command-state = "dsi_hs_mode";
        };
};
