/* Copyright (c) 2012, Code Aurora Forum. All rights reserved.
 *
 * This program is free software; you can redistribute it and/or modify
 * it under the terms of the GNU General Public License version 2 and
 * only version 2 as published by the Free Software Foundation.
 *
 * This program is distributed in the hope that it will be useful,
 * but WITHOUT ANY WARRANTY; without even the implied warranty of
 * MERCHANTABILITY or FITNESS FOR A PARTICULAR PURPOSE.  See the
 * GNU General Public License for more details.
 */

/*---------------------------------------------------------------------------
 * This file is autogenerated file using gcdb parser. Please do not edit it.
 * Update input XML file to add a new entry or update variable in this file
 * VERSION = "1.0"
   *file name:dsi_panel_tianma_otm1284a_tm_5p5_720p_video.h
 *author   :created by tangzhengbo at 20141229
 *when    			      who(by)   			  who(from) 			why
 *2014.12.29		    tangzhengbo	  	         hanwenjun			  create
 *---------------------------------------------------------------------------*/
&mdss_mdp {

	dsi_tianma_otm1284a_tm_5p5_720p_video:qcom,mdss_dsi_tianma_otm1284a_tm_5p5_720p_video {

		qcom,mdss-dsi-panel-name = "zteTIANMA_TM(OTM1284A)_720*1280_5.5Inch";
		qcom,cont-splash-enabled;
		//zte,lcd-product = <101>;
		qcom,mdss-pan-physical-height-dimension = <121>;
		qcom,mdss-pan-physical-width-dimension = <68>;
		qcom,mdss-dsi-panel-controller = <&mdss_dsi0>;
		qcom,mdss-dsi-panel-type = "dsi_video_mode";
		qcom,mdss-dsi-panel-destination = "display_1";
		qcom,mdss-dsi-panel-framerate = <60>;
		qcom,mdss-dsi-virtual-channel-id = <0>;
		qcom,mdss-dsi-stream = <0>;
		qcom,mdss-dsi-panel-width = <720>;
		qcom,mdss-dsi-panel-height = <1280>;
		qcom,mdss-dsi-h-front-porch = <64>;
		qcom,mdss-dsi-h-back-porch = <65>;
		qcom,mdss-dsi-h-pulse-width = <43>;
		qcom,mdss-dsi-h-sync-skew = <0>;
		qcom,mdss-dsi-v-front-porch = <10>;
		qcom,mdss-dsi-v-pulse-width = <5>;
		qcom,mdss-dsi-v-back-porch = <13>;
		qcom,mdss-dsi-h-left-border = <0>;
		qcom,mdss-dsi-h-right-border = <0>;
		qcom,mdss-dsi-v-top-border = <0>;
		qcom,mdss-dsi-v-bottom-border = <0>;
		qcom,mdss-dsi-bpp = <24>;
		qcom,mdss-dsi-color-order = <0>;
		qcom,mdss-dsi-underflow-color = <0xff>;
		qcom,mdss-dsi-border-color = <0>;		
		qcom,mdss-dsi-off-command = [05 01 00 00 32 00 02 28 00
					05 01 00 00 78 00 02 10 00];
		qcom,mdss-dsi-on-command-state = "dsi_lp_mode";
		qcom,mdss-dsi-off-command-state = "dsi_hs_mode";
		qcom,mdss-dsi-h-sync-pulse = <1>;
		qcom,mdss-dsi-traffic-mode = "burst_mode";//default 0
		qcom,mdss-dsi-lane-map = "lane_map_0123";
		qcom,mdss-dsi-bllp-eof-power-mode;
		qcom,mdss-dsi-bllp-power-mode;
		qcom,mdss-dsi-lane-0-state;
		qcom,mdss-dsi-lane-1-state;
		qcom,mdss-dsi-lane-2-state;
		qcom,mdss-dsi-lane-3-state;
		qcom,mdss-dsi-lp11-init;
		qcom,mdss-dsi-panel-timings = [7b 1a 10 00 3e 40 16 1e 15 03 04 a0];
		qcom,mdss-dsi-t-clk-post = <0x04>;
		qcom,mdss-dsi-t-clk-pre = <0x1a>;
		qcom,mdss-dsi-bl-min-level = <1>;
		qcom,mdss-dsi-bl-max-level = <255>;
		qcom,mdss-dsi-dma-trigger = <0x04>;
		qcom,mdss-dsi-mdp-trigger = <0x0>;
		qcom,mdss-dsi-bl-pmic-control-type = "bl_ctrl_dcs";
		//qcom,mdss-dsi-bl-cmd-gpio = <&msmgpio 1 0>;
		qcom,mdss-dsi-reset-sequence = <1 2>, <0 2>, <1 20>;
		qcom,mdss-dsi-on-command = [
29 01 00 00 00 00 02 00 00
29 01 00 00 00 00 04 ff 12 84 01      //EXTC=1
29 01 00 00 00 00 02 00 80      //Orise mode enable
29 01 00 00 00 00 03 ff 12 84
29 01 00 00 00 00 02 00 92  
29 01 00 00 00 00 03 ff 30 02
29 01 00 00 00 00 02 00 80      //RTN
29 01 00 00 00 00 0a c0 00 64 00 0e 12 00 64 0e 12
29 01 00 00 00 00 02 00 81       //frame rate:60Hz
29 01 00 00 00 00 02 c1 55 
29 01 00 00 00 00 02 00 82       //Chopper
29 01 00 00 00 00 02 c4 0a 
29 01 00 00 00 00 02 00 c6       //De-bounce
29 01 00 00 00 00 02 b0 03 
29 01 00 00 00 00 02 00 c2       //precharge disable
29 01 00 00 00 00 02 f5 40 
29 01 00 00 00 00 02 00 c3       //sample hold gvdd
29 01 00 00 00 00 02 f5 85 
29 01 00 00 00 00 02 00 87       //en op
29 01 00 00 00 00 02 c4 18 
29 01 00 00 00 00 02 00 a0      //dcdc setting
29 01 00 00 00 00 0f c4 05 10 06 02 05 15 10 05 10 07 02 05 15 10
29 01 00 00 00 00 02 00 b0     //clamp voltage setting
29 01 00 00 00 00 03 c4 00 00 
29 01 00 00 00 00 02 00 bb     //LVD voltage level setting
29 01 00 00 00 00 02 c5 8a    
29 01 00 00 00 00 02 00 91     //VGH=13V, VGL=-10V, pump ratio:VGH=6x, VGL=-5x
29 01 00 00 00 00 03 c5 36 52 
29 01 00 00 00 00 02 00 00     //GVDD=4.7V, NGVDD=-4.7V
29 01 00 00 00 00 03 d8 8b 8b 
29 01 00 00 00 00 02 00 b3      //VDD_18V=1.7V, LVDSVDD=1.6V
29 01 00 00 00 00 02 c5 84 
29 01 00 00 00 00 02 00 90      //Mode-3
29 01 00 00 00 00 05 f5 02 11 02 15
29 01 00 00 00 00 02 00 90    //2xVPNL, 1.5*=00, 2*=50, 3*=a0
29 01 00 00 00 00 02 c5 50    
29 01 00 00 00 00 02 00 94    //Frequency 
29 01 00 00 00 00 02 c5 66    
29 01 00 00 00 00 02 00 b2    //VGLO1 setting 
29 01 00 00 00 00 03 f5 00 00 
29 01 00 00 00 00 02 00 b6    //VCL pump dis
29 01 00 00 00 00 03 f5 00 00 
29 01 00 00 00 00 02 00 94      //VCL pump dis
29 01 00 00 00 00 03 f5 00 00 
29 01 00 00 00 00 02 00 d2    //VCL reg. en
29 01 00 00 00 00 03 f5 06 15 
29 01 00 00 00 00 02 00 b4      //VGLO Option
29 01 00 00 00 00 02 c5 cc 
29 01 00 00 00 00 02 00 80      //panel timing state control
29 01 00 00 00 00 0c cb 00 00 00 00 00 00 00 00 00 00 00
29 01 00 00 00 00 02 00 90    //panel timing state control                   
29 01 00 00 00 00 10 cb 00 00 00 00 00 00 00 00 00 00 00 00 00 00 00
29 01 00 00 00 00 02 00 a0    //panel timing state control                   
29 01 00 00 00 00 10 cb 00 00 00 00 00 00 00 00 00 00 00 00 00 00 00
29 01 00 00 00 00 02 00 b0    //panel timing state control     
29 01 00 00 00 00 10 cb 00 00 00 00 00 00 00 00 00 00 00 00 00 00 00
29 01 00 00 00 00 02 00 c0       //panel timing state control
29 01 00 00 00 00 10 cb 05 05 05 05 05 05 00 00 00 00 00 00 00 00 00
29 01 00 00 00 00 02 00 d0    //panel timing state control                   
29 01 00 00 00 00 10 cb 00 00 00 00 05 05 05 05 05 05 05 05 05 00 00
29 01 00 00 00 00 02 00 e0    //panel timing state control                   
29 01 00 00 00 00 0f cb 00 00 00 00 00 00 00 00 00 00 00 05 05 05 
29 01 00 00 00 00 02 00 f0    //panel timing state control       
29 01 00 00 00 00 0c cb ff ff ff ff ff ff ff ff ff ff ff     //low voltage detect
29 01 00 00 00 00 02 00 80      //panel pad mapping control
29 01 00 00 00 00 10 cc 0C 0A 10 0E 06 2D 00 00 00 00 00 00 00 00 00
29 01 00 00 00 00 02 00 90    //panel pad mapping control                                        
29 01 00 00 00 00 10 cc 00 00 00 00 2E 02 04 0B 09 0F 0D 05 2D 00 00
29 01 00 00 00 00 02 00 a0    //panel pad mapping control                                        
29 01 00 00 00 00 0f cc 00 00 00 00 00 00 00 00 00 00 00 2E 01 03 
29 01 00 00 00 00 02 00 b0    //panel pad mapping control                                        
29 01 00 00 00 00 10 cc 0D 0F 09 0B 05 2E 00 00 00 00 00 00 00 00 00
29 01 00 00 00 00 02 00 c0    //panel pad mapping control                                        
29 01 00 00 00 00 10 cc 00 00 00 00 2D 03 01 0E 10 0A 0C 06 2E 00 00
29 01 00 00 00 00 02 00 d0    //panel pad mapping control                                        
29 01 00 00 00 00 0f cc 00 00 00 00 00 00 00 00 00 00 00 05 04 02 
29 01 00 00 00 00 02 00 80      //panel VST setting                                              
29 01 00 00 00 00 0d ce 8b 03 18 8a 03 18 89 03 18 88 03 18       
29 01 00 00 00 00 02 00 90    //panel VEND setting                                               
29 01 00 00 00 00 0f ce 38 0f 18 38 0e 18 00 00 00 00 00 00 00 00 
29 01 00 00 00 00 02 00 a0    //panel CLKA1/2 setting                                            
29 01 00 00 00 00 0f ce 38 07 05 00 00 18 00 38 06 05 01 00 18 00 
29 01 00 00 00 00 02 00 b0    //panel CLKA3/4 setting                                            
29 01 00 00 00 00 0f ce 38 05 05 02 00 18 00 38 04 05 03 00 18 00 
29 01 00 00 00 00 02 00 c0    //panel CLKb1/2 setting                                            
29 01 00 00 00 00 0f ce 38 03 05 04 00 18 00 38 02 05 05 00 18 00 
29 01 00 00 00 00 02 00 d0    //panel CLKb3/4 setting                                            
29 01 00 00 00 00 0f ce 38 01 05 06 00 18 00 38 00 05 07 00 18 00 
29 01 00 00 00 00 02 00 80    //panel CLKc1/2 setting                                                                                     
29 01 00 00 00 00 0f cf 00 00 00 00 00 00 00 00 00 00 00 00 00 00 
29 01 00 00 00 00 02 00 90    //panel CLKd1/2 setting                                            
29 01 00 00 00 00 0f cf 00 00 00 00 00 00 00 00 00 00 00 00 00 00 
29 01 00 00 00 00 02 00 a0    //panel CLKd3/4 setting                                            
29 01 00 00 00 00 0f cf 00 00 00 00 00 00 00 00 00 00 00 00 00 00 
29 01 00 00 00 00 02 00 b0       //panel CLKd3/4 setting
29 01 00 00 00 00 0f cf  00 00 00 00 00 00 00 00 00 00 00 00 00 00 
29 01 00 00 00 00 02 00 c0    //panel ECLK setting                                      
29 01 00 00 00 00 0c cf  01 01 20 20 00 00 01 81 00 03 08      //gate pre. ena.
29 01 00 00 00 00 02 00 b5    //TCON_GOA_OUT Setting                     
29 01 00 00 00 00 07 c5 38 00 3f 38 00 3f      //normal output with VGH/VGL
29 01 00 00 00 00 02 00 00 
29 01 00 00 00 00 15 E1 10 2a 37 45 54 62 63 8e 7d 97 6c 56 66 40 3f 31 23 12 0a 00
29 01 00 00 00 00 02  00 00 
29 01 00 00 00 00 15 E2 10 29 36 45 54 62 63 8e 7d 97 6c 56 66 40 3f 31 23 12 0a 00
29 01 00 00 00 00 02 00 B1  //pwm=34.17Khz 20150914
29 01 00 00 00 00 02 C6 03
29 01 00 00 00 00 02 00 B4
29 01 00 00 00 00 02 C6 13
29 01 00 00 00 00 02 00 00    //Command 2 Disable
29 01 00 00 00 00 04 ff ff ff ff

//39 00 00 00 00 00 02 51 ff                     
//39 00 00 00 00 00 02 53 2c 

05 01 00 00 78 00 02 11 00 
05 01 00 00 0a 00 02 29 00];
 };
};
