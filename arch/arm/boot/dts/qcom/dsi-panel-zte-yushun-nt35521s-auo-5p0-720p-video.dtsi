/* Copyright (c) 2012, Code Aurora Forum. All rights reserved.
 *
 * This program is free software; you can redistribute it and/or modify
 * it under the terms of the GNU General Public License version 2 and
 * only version 2 as published by the Free Software Foundation.
 *
 * This program is distributed in the hope that it will be useful,
 * but WITHOUT ANY WARRANTY; without even the implied warranty of
 * MERCHANTABILITY or FITNESS FOR A PARTICULAR PURPOSE.  See the
 * GNU General Public License for more details.
 */

/*---------------------------------------------------------------------------
 * This file is autogenerated file using gcdb parser. Please do not edit it.
 * Update input XML file to add a new entry or update variable in this file
 * VERSION = "1.0"
   *file name:dsi_panel_tianma_otm1284a_tm_5p5_720p_video.h
 *author   :created by tangzhengbo at 20141229
 *when    			      who(by)   			  who(from) 			why
 *2014.12.29		    tangzhengbo	  	         hanwenjun			  create
 *---------------------------------------------------------------------------*/
&mdss_mdp {

	dsi_yushun_nt35521s_auo_5p0_720p_video:qcom,mdss_dsi_yushun_nt35521s_auo_5p0_720p_video {

		qcom,mdss-dsi-panel-name = "zteYUSHUN_AUO(NT35521S)_720*1280_5.0Inch";
		qcom,cont-splash-enabled;		
		//qcom,mdss-pan-physical-height-dimension = <121>;
		//qcom,mdss-pan-physical-width-dimension = <68>;
		qcom,mdss-dsi-panel-controller = <&mdss_dsi0>;
		qcom,mdss-dsi-panel-type = "dsi_video_mode";
		qcom,mdss-dsi-panel-destination = "display_1";
		qcom,mdss-dsi-panel-framerate = <60>;
		qcom,mdss-dsi-virtual-channel-id = <0>;
		qcom,mdss-dsi-stream = <0>;
		qcom,mdss-dsi-panel-width = <720>;
		qcom,mdss-dsi-panel-height = <1280>;
		qcom,mdss-dsi-h-front-porch = <156>;//156->457M//mipi clk=426.98,wangfei and jiayutao on 20151-26	
		qcom,mdss-dsi-h-back-porch = <86>;
		qcom,mdss-dsi-h-pulse-width =  <6>;//<12>;
		qcom,mdss-dsi-h-sync-skew = <0>;
		qcom,mdss-dsi-v-front-porch = <16>;
		qcom,mdss-dsi-v-back-porch = <14>;		
		qcom,mdss-dsi-v-pulse-width = <2>;	
		qcom,mdss-dsi-h-left-border = <0>;
		qcom,mdss-dsi-h-right-border = <0>;
		qcom,mdss-dsi-v-top-border = <0>;
		qcom,mdss-dsi-v-bottom-border = <0>;
		qcom,mdss-dsi-bpp = <24>;
		qcom,mdss-dsi-color-order = <0>;
		qcom,mdss-dsi-underflow-color = <0xff>;
		qcom,mdss-dsi-border-color = <0>;		
		qcom,mdss-dsi-off-command = [05 01 00 00 32 00 02 28 00
					05 01 00 00 78 00 02 10 00];
		qcom,mdss-dsi-on-command-state = "dsi_lp_mode";
		qcom,mdss-dsi-off-command-state = "dsi_hs_mode";
		qcom,mdss-dsi-h-sync-pulse = <1>;
		qcom,mdss-dsi-traffic-mode = "burst_mode";//default 0
		qcom,mdss-dsi-lane-map = "lane_map_0123";
		qcom,mdss-dsi-bllp-eof-power-mode;
		qcom,mdss-dsi-bllp-power-mode;
		qcom,mdss-dsi-lane-0-state;
		qcom,mdss-dsi-lane-1-state;
		qcom,mdss-dsi-lane-2-state;
		qcom,mdss-dsi-lane-3-state;
		qcom,mdss-dsi-lp11-init;
		qcom,mdss-dsi-panel-timings = [87 1c 12 00 42 44 18 20 17 03 04 a0];
		qcom,mdss-dsi-t-clk-post = <0x04>;
		qcom,mdss-dsi-t-clk-pre = <0x1b>;
		qcom,mdss-dsi-bl-min-level = <1>;
		qcom,mdss-dsi-bl-max-level = <255>;
		qcom,mdss-dsi-dma-trigger = <0x04>;
		qcom,mdss-dsi-mdp-trigger = <0x0>;
		qcom,mdss-dsi-bl-pmic-control-type = "bl_ctrl_dcs";
		//qcom,mdss-dsi-bl-cmd-gpio = <&msmgpio 1 0>;
		qcom,mdss-dsi-reset-sequence = <1 2>, <0 2>, <1 20>;
		qcom,mdss-dsi-on-command = [

		39 01 00 00 00 00 06 f0 55 aa 52 08 04 //change OSC from 55M to 57M to avoid RF interference
		39 01 00 00 00 00 02 c3 83
		
		 39 01 00 00 00 00 05 ff aa 55 25 01 
                39 01 00 00 00 00 02 6f 21   
                39 01 00 00 01 00 02 f7 01   
                39 01 00 00 00 00 02 6f 21   
                39 01 00 00 00 00 02 f7 00   
                39 01 00 00 01 00 02 FC 08   
                39 01 00 00 00 00 02 FC 00   
                39 01 00 00 00 00 02 6F 1A   
                39 01 00 00 00 00 02 F7 05   
                39 01 00 00 00 00 05 FF AA 55 25 00 
                39 01 00 00 00 00 06 F0 55 AA 52 08 00   
                39 01 00 00 00 00 03 B1 68 21   
                39 01 00 00 00 00 02 B6 01   
                39 01 00 00 00 00 05 B8 01 02 08 02 
                39 01 00 00 00 00 03 BB 74 74   
                39 01 00 00 00 00 02 C7 02   
                39 01 00 00 00 00 03 BC 05 05   
                39 01 00 00 00 00 02 C8 80   
                39 01 00 00 00 00 04 D9 01 01 6E 
                39 01 00 00 00 00 06 F0 55 AA 52 08 01   
                39 01 00 00 00 00 03 B3 28 28   
                39 01 00 00 00 00 03 B4 19 19   
                39 01 00 00 00 00 03 B5 05 05   
                39 01 00 00 00 00 03 B9 34 34   
                39 01 00 00 00 00 03 BA 26 26   
                39 01 00 00 00 00 03 BC 88 00   
                39 01 00 00 00 00 03 BD 88 00   
                39 01 00 00 00 00 02 BE 69   
                39 01 00 00 00 00 02 C0 0C   
                39 01 00 00 00 00 02 CA 00   
                39 01 00 00 00 00 06 F0 55 AA 52 08 02   
                39 01 00 00 00 00 02 EE 01   
                39 01 00 00 00 00 02 ED 03   
                39 01 00 00 00 00 11 B0 00 00 00 1D 00 44 00 62 00 78 00 97 00 BB 00 EC 
                39 01 00 00 00 00 11 B1 01 13 01 50 01 83 01 D1 02 13 02 15 02 55 02 9C 
                39 01 00 00 00 00 11 B2 02 C2 02 FD 03 1F 03 54 03 6D 03 96 03 B1 03 D1 
                39 01 00 00 00 00 05 B3 03 F2 03 FF 
                39 01 00 00 00 00 06 F0 55 AA 52 08 03   
                39 01 00 00 00 00 03 B0 00 00   
                39 01 00 00 00 00 03 B1 00 00   
                39 01 00 00 00 00 06 B2 04 00 40 01 58   
                39 01 00 00 00 00 06 B3 04 00 40 01 58   
                39 01 00 00 00 00 06 B6 04 00 46 01 68   
                39 01 00 00 00 00 06 B7 04 00 46 01 68   
                39 01 00 00 00 00 06 BA 44 00 46 01 55   
                39 01 00 00 00 00 06 BB 44 00 46 01 55   
                39 01 00 00 00 00 06 BC 53 00 15 00 48   
                39 01 00 00 00 00 06 BD 53 00 15 00 48   
                39 01 00 00 00 00 02 C4 60   
                39 01 00 00 00 00 02 C5 40   
                39 01 00 00 00 00 06 F0 55 AA 52 08 05   
                39 01 00 00 00 00 03 B0 17 06   
                39 01 00 00 00 00 03 B1 17 06   
                39 01 00 00 00 00 03 B2 17 06   
                39 01 00 00 00 00 03 B3 17 06   
                39 01 00 00 00 00 03 B4 17 06   
                39 01 00 00 00 00 03 B5 17 06   
                39 01 00 00 00 00 03 B6 17 06   
                39 01 00 00 00 00 03 B7 17 06   
                39 01 00 00 00 00 02 B8 00   
                39 01 00 00 00 00 02 B9 00   
                39 01 00 00 00 00 02 BA 00   
                39 01 00 00 00 00 02 BB 00   
                39 01 00 00 00 00 02 BC 00   
                39 01 00 00 00 00 06 BD 0F 03 03 00 03   
                39 01 00 00 00 00 02 C0 07   
                39 01 00 00 00 00 02 C1 05   
                39 01 00 00 00 00 02 C4 82   
                39 01 00 00 00 00 02 C5 80   
                39 01 00 00 00 00 03 C8 03 20   
                39 01 00 00 00 00 03 C9 01 21   
                39 01 00 00 00 00 03 CA 03 20   
                39 01 00 00 00 00 03 CB 07 20   
                39 01 00 00 00 00 0C D1 03 05 00 05 00 00 00 00 00 00 00 
                39 01 00 00 00 00 0C D2 03 05 00 03 00 00 00 00 00 00 00 
                39 01 00 00 00 00 0C D3 03 05 04 05 00 00 00 00 00 00 00 
                39 01 00 00 00 00 0C D4 03 05 04 03 00 00 00 00 00 00 00 
                39 01 00 00 00 00 02 E5 06   
                39 01 00 00 00 00 02 E6 06   
                39 01 00 00 00 00 02 E7 06   
                39 01 00 00 00 00 02 E8 06   
                39 01 00 00 00 00 02 E9 0A   
                39 01 00 00 00 00 02 EA 06   
                39 01 00 00 00 00 02 EB 06   
                39 01 00 00 00 00 02 EC 06   
                39 01 00 00 00 00 02 ED 30   
                39 01 00 00 00 00 06 F0 55 AA 52 08 06   
                39 01 00 00 00 00 03 B0 2E 2E   
                39 01 00 00 00 00 03 B1 2E 2E   
                39 01 00 00 00 00 03 B2 2E 2E   
                39 01 00 00 00 00 03 B3 2E 09   
                39 01 00 00 00 00 03 B4 0B 23   
                39 01 00 00 00 00 03 B5 1D 1F   
                39 01 00 00 00 00 03 B6 11 17   
                39 01 00 00 00 00 03 B7 13 19   
                39 01 00 00 00 00 03 B8 01 03   
                39 01 00 00 00 00 03 B9 2E 2E   
                39 01 00 00 00 00 03 BA 2E 2E   
                39 01 00 00 00 00 03 BB 02 00   
                39 01 00 00 00 00 03 BC 18 12   
                39 01 00 00 00 00 03 BD 16 10   
                39 01 00 00 00 00 03 BE 1E 1C   
                39 01 00 00 00 00 03 BF 22 0A   
                39 01 00 00 00 00 03 C0 08 2E   
                39 01 00 00 00 00 03 C1 2E 2E   
                39 01 00 00 00 00 03 C2 2E 2E   
                39 01 00 00 00 00 03 C3 2E 2E   
                39 01 00 00 00 00 03 E5 25 24   
                39 01 00 00 00 00 03 C4 2E 2E   
                39 01 00 00 00 00 03 C5 2E 2E   
                39 01 00 00 00 00 03 C6 2E 2E   
                39 01 00 00 00 00 03 C7 2E 02   
                39 01 00 00 00 00 03 C8 00 24   
                39 01 00 00 00 00 03 C9 1E 1C   
                39 01 00 00 00 00 03 CA 18 12   
                39 01 00 00 00 00 03 CB 16 10   
                39 01 00 00 00 00 03 CC 0A 08   
                39 01 00 00 00 00 03 CD 2E 2E   
                39 01 00 00 00 00 03 CE 2E 2E   
                39 01 00 00 00 00 03 CF 09 0B   
                39 01 00 00 00 00 03 D0 11 17   
                39 01 00 00 00 00 03 D1 13 19   
                39 01 00 00 00 00 03 D2 1D 1F   
                39 01 00 00 00 00 03 D3 25 01   
                39 01 00 00 00 00 03 D4 03 2E   
                39 01 00 00 00 00 03 D5 2E 2E   
                39 01 00 00 00 00 03 D6 2E 2E   
                39 01 00 00 00 00 03 D7 2E 2E   
                39 01 00 00 00 00 03 E6 22 23   
                39 01 00 00 00 00 06 D8 00 00 00 00 00   
                39 01 00 00 00 00 06 D9 00 00 00 00 00   
                39 01 00 00 00 00 02 E7 00   
                39 01 00 00 00 00 02 62 01   
                //39 01 00 00 00 00 02 51 FF 
                39 01 00 00 00 00 02 53 24 
                39 01 00 00 00 00 02 55 00 
                05 01 00 00 78 00 02 11 00     
                05 01 00 00 0A 00 02 29 00   


//39 01 00 00 00 00 06 F0 55 AA 52 08 00  //nt35521s bist mode
//39 01 00 00 00 00 05 ee 87 78 02 40 

];
 };
};
