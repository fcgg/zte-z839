/* Copyright (c) 2012, Code Aurora Forum. All rights reserved.
 *
 * This program is free software; you can redistribute it and/or modify
 * it under the terms of the GNU General Public License version 2 and
 * only version 2 as published by the Free Software Foundation.
 *
 * This program is distributed in the hope that it will be useful,
 * but WITHOUT ANY WARRANTY; without even the implied warranty of
 * MERCHANTABILITY or FITNESS FOR A PARTICULAR PURPOSE.  See the
 * GNU General Public License for more details.
 */

/*---------------------------------------------------------------------------
 * This file is autogenerated file using gcdb parser. Please do not edit it.
 * Update input XML file to add a new entry or update variable in this file
 * VERSION = "1.0"
  *file name:dsi-panel-zte-lead-fl10802-cpt-fwvga-5p0-video.dtsi
 *author   :created by tangzhengbo at 20141209
 *when    			     who(by)   			who(from) 			why
 *2014.12.09		   tangzhengbo	  	       quzhongqui		     create
 *---------------------------------------------------------------------------*/
&mdss_mdp {
	dsi_lead_fl10802_cpt_fwvga_vid: qcom,lcd_lead_fl10802_cpt_fwvga_video {
		qcom,mdss-dsi-panel-name = "zteLEAD(FL10802)CPT_480*854_5P0Inch";
		zte,lcd-proc-panel-name = "zteLEAD(FL10802)CPT_480*854_5P0Inch";
		qcom,cont-splash-enabled;		
 		qcom,mdss-dsi-panel-controller = <&mdss_dsi0>;
		qcom,mdss-dsi-panel-type = "dsi_video_mode";
		qcom,mdss-dsi-panel-destination = "display_1";
		qcom,mdss-dsi-panel-framerate = <60>;
		qcom,mdss-dsi-virtual-channel-id = <0>;
		qcom,mdss-dsi-stream = <0>;
		qcom,mdss-pan-physical-height-dimension = <110>;
		qcom,mdss-pan-physical-width-dimension = <62>;
		qcom,mdss-dsi-panel-width = <480>;
		qcom,mdss-dsi-panel-height = <854>;
	       qcom,mdss-dsi-h-front-porch = <94>;
		qcom,mdss-dsi-h-back-porch = <84>;
		qcom,mdss-dsi-h-pulse-width = <59>;
		qcom,mdss-dsi-h-sync-skew = <0>;
		qcom,mdss-dsi-v-back-porch = <12>;
		qcom,mdss-dsi-v-front-porch = <18>;
		qcom,mdss-dsi-v-pulse-width = <4>;
		qcom,mdss-dsi-h-left-border = <0>;
		qcom,mdss-dsi-h-right-border = <0>;
		qcom,mdss-dsi-v-top-border = <0>;
		qcom,mdss-dsi-v-bottom-border = <0>;
		qcom,mdss-dsi-bpp = <24>;
		qcom,mdss-dsi-color-order = <0>;
		qcom,mdss-dsi-underflow-color = <0xff>;
		qcom,mdss-dsi-border-color = <0>;
		qcom,mdss-dsi-on-command = [
			29 01 00 00 00 00 04 B9 F1 08 01 
			29 01 00 00 00 00 08 B1 2a 1A 1A 87 30 01 AB				  //decrease noise to tp,20150330 
			29 01 00 00 00 00 02 B2 22			
			29 01 00 00 00 00 09 B3 01 00 06 06 18 13 39 35 
			29 01 00 00 00 00 12 BA 31 00 44 25 91 0A 00 00 C1 00 00 00 0D 02 4F B9 EE 
			29 01 00 00 00 00 06 E3 09 09 03 03 00			   
			29 01 00 00 00 00 02 B4 00						   
			29 01 00 00 00 00 03 B5 07 07					   
			29 01 00 00 00 00 03 B6 32 32					   
			29 01 00 00 00 00 03 B8 64 22 


29 01 00 00 00 00 02 C7 A0      //backlight direction
29 01 00 00 00 00 03 C8 10 00  //pwm frequency=30kHz
                              
29 01 00 00 00 00 02 CC 00                         
29 01 00 00 00 00 02 BC 47                         
                              
29 01 00 00 00 00 34 E9 00 00 09 03 65 0A 8A 10 01 00 37 0D 0A 8A 37 00 00 18 00 00 00 25 09 80 40 00 42 60 00 00 00 09 81 50 01 53 70 00 00 00 00 00 00 00 00 00 00 00 00 00 00                         
                              
29 01 00 00 00 00 13 EA 94 00 00 00 08 95 10 07 35 10 00 00 00 08 94 00 06 24    
                              
29 01 00 00 00 00 23 E0 00 00 11 0F 10 2A 26 34 0C 0F 10 14 17 14 16 13 17 00 00 11 0F 10 2A 26 34 0C 0F 10 14 17 14 16 13 17    

				05 01 00 00 78 00 02 11 00 
				05 01 00 00 78 00 02 29 00


];		
                qcom,mdss-dsi-off-command = [05 01 00 00 32 00 02 28 00
                                       05 01 00 00 78 00 02 10 00];
               qcom,mdss-dsi-on-command-state = "dsi_lp_mode";
                qcom,mdss-dsi-off-command-state = "dsi_hs_mode";
		qcom,mdss-dsi-h-sync-pulse = <0>;
		qcom,mdss-dsi-traffic-mode = "non_burst_sync_event";
		qcom,mdss-dsi-lane-map = "lane_map_3012";
		qcom,mdss-dsi-bllp-eof-power-mode;
		qcom,mdss-dsi-bllp-power-mode;
		qcom,mdss-dsi-lane-0-state;
		qcom,mdss-dsi-lane-1-state;
		qcom,mdss-dsi-lp11-init;
		//qcom,mdss-dsi-panel-timings =[82 1c 12 00 40 42 16 1e 14 03 04 a0];
		qcom,mdss-dsi-panel-timings =[87 1c 12 00 42 44 18 20 17 03 04 a0];
		qcom,mdss-dsi-t-clk-post = <0x04>;
		qcom,mdss-dsi-t-clk-pre = <0x1b>;
		qcom,mdss-dsi-bl-min-level = <1>;
		qcom,mdss-dsi-bl-max-level = <255>;
		qcom,mdss-dsi-dma-trigger = <0x04>;
		qcom,mdss-dsi-mdp-trigger = <0x0>;
		qcom,mdss-dsi-bl-pmic-control-type = "bl_ctrl_dcs";
		//qcom,mdss-dsi-bl-pmic-control-type = "bl_ctrl_gpio";
		//qcom,mdss-dsi-bl-cmd-gpio = <&msm_gpio 97 0>;
		qcom,mdss-dsi-reset-sequence = <1 20>, <0 10>, <1 20>;

		

								
 
        };
};
