/* Copyright (c) 2012, Code Aurora Forum. All rights reserved.
 *
 * This program is free software; you can redistribute it and/or modify
 * it under the terms of the GNU General Public License version 2 and
 * only version 2 as published by the Free Software Foundation.
 *
 * This program is distributed in the hope that it will be useful,
 * but WITHOUT ANY WARRANTY; without even the implied warranty of
 * MERCHANTABILITY or FITNESS FOR A PARTICULAR PURPOSE.  See the
 * GNU General Public License for more details.
 */

 /*---------------------------------------------------------------------------
 * This file is autogenerated file using gcdb parser. Please do not edit it.
 * Update input XML file to add a new entry or update variable in this file
 * VERSION = "1.0"
 *file name:dsi-panel-zte-dijing-ili9881c-boe-5p5-720p-video.h
 *author   :created by tangzhengbo at 20151203
 *when    			   who(by)   			who(from) 			  why
 *2015.12.03	  tangzhengbo	  	  huwenlong		     create
 *---------------------------------------------------------------------------*/
&mdss_mdp {

        dsi_ili9881c_boe_720p_vid: qcom,mdss_dsi_dijing_ili9881c_boe_5p5_720p_video{
        	qcom,mdss-dsi-panel-name =  "zteDIJING(ili9881c)BOE_720*1280_5.5Inch";             
		qcom,cont-splash-enabled; 		
 		qcom,mdss-dsi-panel-controller = <&mdss_dsi0>;
		qcom,mdss-dsi-panel-type = "dsi_video_mode";
		qcom,mdss-dsi-panel-destination = "display_1";
		qcom,mdss-dsi-panel-framerate = <60>;
		qcom,mdss-dsi-virtual-channel-id = <0>;
		qcom,mdss-dsi-stream = <0>;
		qcom,mdss-dsi-panel-width = <720>;
		qcom,mdss-dsi-panel-height = <1280>;
		qcom,mdss-dsi-h-front-porch = <66>;//mipi clk=425.09,xiaoyu and maojianfeng	
		qcom,mdss-dsi-h-back-porch = <60>;
		qcom,mdss-dsi-h-pulse-width =  <20>;//<12>;
		qcom,mdss-dsi-h-sync-skew = <0>;
		qcom,mdss-dsi-v-front-porch = <20>;
		qcom,mdss-dsi-v-back-porch = <20>;		
		qcom,mdss-dsi-v-pulse-width = <8>;
		qcom,mdss-dsi-h-left-border = <0>;
		qcom,mdss-dsi-h-right-border = <0>;
		qcom,mdss-dsi-v-top-border = <0>;
		qcom,mdss-dsi-v-bottom-border = <0>;
		qcom,mdss-dsi-bpp = <24>;
		qcom,mdss-dsi-color-order = <0>;
		qcom,mdss-dsi-underflow-color = <0xff>;
		qcom,mdss-dsi-border-color = <0>;
		qcom,mdss-dsi-h-sync-pulse = <0>;
		qcom,mdss-dsi-traffic-mode = <1>;		
		qcom,mdss-dsi-lane-map = "lane_map_0123";
		qcom,mdss-dsi-bllp-eof-power-mode;
		qcom,mdss-dsi-bllp-power-mode;
		qcom,suspend-ulps-enabled;
		qcom,mdss-dsi-lane-0-state;
		qcom,mdss-dsi-lane-1-state;
		qcom,mdss-dsi-lane-2-state;
		qcom,mdss-dsi-lane-3-state;
		qcom,mdss-dsi-lp11-init;
		qcom,mdss-dsi-panel-timings =[6a 16 0e 00 38 3a 12 1a 10 03 04 a0];
		qcom,mdss-dsi-t-clk-post = <0x04>;
		qcom,mdss-dsi-t-clk-pre = <0x17>;
		qcom,mdss-dsi-bl-min-level = <1>;
		qcom,mdss-dsi-bl-max-level = <255>;
		qcom,mdss-dsi-dma-trigger = <0x04>;
		qcom,mdss-dsi-mdp-trigger = <0x0>;
		qcom,mdss-dsi-bl-pmic-control-type = "bl_ctrl_dcs";
		//qcom,mdss-dsi-bl-cmd-gpio = <&msmgpio 33 0>;
		qcom,mdss-dsi-reset-sequence = <1 5>, <0 5>, <1 20>;
		qcom,mdss-pan-physical-width-dimension = <68>;
		qcom,mdss-pan-physical-height-dimension = <121>;
                qcom,mdss-dsi-on-command= [

39 01 00 00 00 00 04 FF 98 81 03 

//GIP_1
39 01 00 00 00 00 02 01 00 
39 01 00 00 00 00 02 02 00 
39 01 00 00 00 00 02 03 73 
39 01 00 00 00 00 02 04 00 
39 01 00 00 00 00 02 05 00 
39 01 00 00 00 00 02 06 0C 
39 01 00 00 00 00 02 07 00 
39 01 00 00 00 00 02 08 00 
39 01 00 00 00 00 02 09 19 
39 01 00 00 00 00 02 0a 01 
39 01 00 00 00 00 02 0b 01 
39 01 00 00 00 00 02 0c 0B 
39 01 00 00 00 00 02 0d 01 
39 01 00 00 00 00 02 0e 01 
39 01 00 00 00 00 02 0f 26 
39 01 00 00 00 00 02 10 26 
39 01 00 00 00 00 02 11 00 
39 01 00 00 00 00 02 12 00 
39 01 00 00 00 00 02 13 02 
39 01 00 00 00 00 02 14 00 
39 01 00 00 00 00 02 15 00 
39 01 00 00 00 00 02 16 00 
39 01 00 00 00 00 02 17 00 
39 01 00 00 00 00 02 18 00 
39 01 00 00 00 00 02 19 00 
39 01 00 00 00 00 02 1a 00 
39 01 00 00 00 00 02 1b 00 
39 01 00 00 00 00 02 1c 00 
39 01 00 00 00 00 02 1d 00 
39 01 00 00 00 00 02 1e 44 
39 01 00 00 00 00 02 1f C0  
39 01 00 00 00 00 02 20 0A 
39 01 00 00 00 00 02 21 03 
39 01 00 00 00 00 02 22 0A  
39 01 00 00 00 00 02 23 00 
39 01 00 00 00 00 02 24 8C  
39 01 00 00 00 00 02 25 8C 
39 01 00 00 00 00 02 26 00 
39 01 00 00 00 00 02 27 00 
39 01 00 00 00 00 02 28 3b      //0x33
39 01 00 00 00 00 02 29 03 
39 01 00 00 00 00 02 2a 00 
39 01 00 00 00 00 02 2b 00 
39 01 00 00 00 00 02 2c 00 
39 01 00 00 00 00 02 2d 00 
39 01 00 00 00 00 02 2e 00 
39 01 00 00 00 00 02 2f 00 
39 01 00 00 00 00 02 30 00 
39 01 00 00 00 00 02 31 00 
39 01 00 00 00 00 02 32 00 
39 01 00 00 00 00 02 33 00 
39 01 00 00 00 00 02 34 00 
39 01 00 00 00 00 02 35 00 
39 01 00 00 00 00 02 36 00 
39 01 00 00 00 00 02 37 00 
39 01 00 00 00 00 02 38 00 
39 01 00 00 00 00 02 39 00 
39 01 00 00 00 00 02 3a 00 
39 01 00 00 00 00 02 3b 00 
39 01 00 00 00 00 02 3c 00 
39 01 00 00 00 00 02 3d 00 
39 01 00 00 00 00 02 3e 00 
39 01 00 00 00 00 02 3f 00 
39 01 00 00 00 00 02 40 00 
39 01 00 00 00 00 02 41 00 
39 01 00 00 00 00 02 42 00 
39 01 00 00 00 00 02 43 00 
39 01 00 00 00 00 02 44 00 

//GIP_2
39 01 00 00 00 00 02 50 01 
39 01 00 00 00 00 02 51 23 
39 01 00 00 00 00 02 52 45 
39 01 00 00 00 00 02 53 67 
39 01 00 00 00 00 02 54 89 
39 01 00 00 00 00 02 55 ab 
39 01 00 00 00 00 02 56 01 
39 01 00 00 00 00 02 57 23 
39 01 00 00 00 00 02 58 45 
39 01 00 00 00 00 02 59 67 
39 01 00 00 00 00 02 5a 89 
39 01 00 00 00 00 02 5b ab 
39 01 00 00 00 00 02 5c cd 
39 01 00 00 00 00 02 5d ef 

//GIP_3
39 01 00 00 00 00 02 5e 11 
39 01 00 00 00 00 02 5f 02 
39 01 00 00 00 00 02 60 00 
39 01 00 00 00 00 02 61 0C 
39 01 00 00 00 00 02 62 0D 
39 01 00 00 00 00 02 63 0E 
39 01 00 00 00 00 02 64 0F 
39 01 00 00 00 00 02 65 02 
39 01 00 00 00 00 02 66 02 
39 01 00 00 00 00 02 67 02 
39 01 00 00 00 00 02 68 02 
39 01 00 00 00 00 02 69 02 
39 01 00 00 00 00 02 6a 02 
39 01 00 00 00 00 02 6b 02 
39 01 00 00 00 00 02 6c 02 
39 01 00 00 00 00 02 6d 02 
39 01 00 00 00 00 02 6e 05 
39 01 00 00 00 00 02 6f 05 
39 01 00 00 00 00 02 70 05 
39 01 00 00 00 00 02 71 05 
39 01 00 00 00 00 02 72 01 
39 01 00 00 00 00 02 73 06 
39 01 00 00 00 00 02 74 07 
39 01 00 00 00 00 02 75 02 
39 01 00 00 00 00 02 76 00 
39 01 00 00 00 00 02 77 0C 
39 01 00 00 00 00 02 78 0D 
39 01 00 00 00 00 02 79 0E 
39 01 00 00 00 00 02 7a 0F 
39 01 00 00 00 00 02 7b 02 
39 01 00 00 00 00 02 7c 02 
39 01 00 00 00 00 02 7d 02 
39 01 00 00 00 00 02 7e 02 
39 01 00 00 00 00 02 7f 02 
39 01 00 00 00 00 02 80 02 
39 01 00 00 00 00 02 81 02 
39 01 00 00 00 00 02 82 02 
39 01 00 00 00 00 02 83 02 
39 01 00 00 00 00 02 84 05 
39 01 00 00 00 00 02 85 05 
39 01 00 00 00 00 02 86 05 
39 01 00 00 00 00 02 87 05 
39 01 00 00 00 00 02 88 01 
39 01 00 00 00 00 02 89 06 
39 01 00 00 00 00 02 8A 07 

//CMD_Page 4
39 01 00 00 00 00 04 FF 98 81 04 
39 01 00 00 00 00 02 6C 15 
39 01 00 00 00 00 02 6E 1A              //di_pwr_reg=0 VGH clamp 15V
39 01 00 00 00 00 02 6F 25              // reg vcl + VGH pumping ratio 3x VGL=-2x
39 01 00 00 00 00 02 3A A4                
39 01 00 00 00 00 02 8D 20              //VGL clamp -10V
39 01 00 00 00 00 02 87 BA      
39 01 00 00 00 00 02 26 76 		        //5.2 none
39 01 00 00 00 00 02 b2 d1            //5.2 none

//CMD_Page 1
39 01 00 00 00 00 04 FF 98 81 01 
39 01 00 00 00 00 02 22 0A 		         //BGR, SS
39 01 00 00 00 00 02 53 7D 		         //VCOM1
39 01 00 00 00 00 02 55 8A 		         //VCOM2
39 01 00 00 00 00 02 50 95          	//VREG1OUT=4.9V
39 01 00 00 00 00 02 51 95          	//VREG2OUT=-4.9V
39 01 00 00 00 00 02 31 00 		        //column inversion
39 01 00 00 00 00 02 60 15            //09     //SDT
39 01 00 00 00 00 02 61 01                //SDT
39 01 00 00 00 00 02 62 0c                //SDT
39 01 00 00 00 00 02 63 00                //SDT


//VP255	Gamma P
39 01 00 00 00 00 02 A0 1D 
//VP251		
39 01 00 00 00 00 02 A1 26 
//VP247                       
39 01 00 00 00 00 02 A2 2e 
//VP243                       
39 01 00 00 00 00 02 A3 14 
//VP239                       
39 01 00 00 00 00 02 A4 14  
//VP231                       
39 01 00 00 00 00 02 A5 21 
//VP219                       
39 01 00 00 00 00 02 A6 17 
//VP203                      
39 01 00 00 00 00 02 A7 19 
//VP175                       
39 01 00 00 00 00 02 A8 65 
//VP144                       
39 01 00 00 00 00 02 A9 1b 
//VP111                       
39 01 00 00 00 00 02 AA 28 
//VP80                       
39 01 00 00 00 00 02 AB 4e 
//VP52                        
39 01 00 00 00 00 02 AC 12 
//VP36                        
39 01 00 00 00 00 02 AD 0a 
//VP24                        
39 01 00 00 00 00 02 AE 38 
//VP16                        
39 01 00 00 00 00 02 AF 00 
//VP12                        
39 01 00 00 00 00 02 B0 00 
//VP8                        
39 01 00 00 00 00 02 B1 5E 
//VP4                         
39 01 00 00 00 00 02 B2 6D 
//VP0                          
39 01 00 00 00 00 02 B3 39                        


//VN255 GAMMA N                                               
39 01 00 00 00 00 02 C0 1D 		
//VN251
39 01 00 00 00 00 02 C1 25 
//VN247                       
39 01 00 00 00 00 02 C2 2c 
//VN243                      
39 01 00 00 00 00 02 C3 07 
//VN239                        
39 01 00 00 00 00 02 C4 08 
//VN231                      
39 01 00 00 00 00 02 C5 1d 
//VN219                       
39 01 00 00 00 00 02 C6 11 
//VN203                       
39 01 00 00 00 00 02 C7 14 
//VN175                       
39 01 00 00 00 00 02 C8 66 
//VN144                       
39 01 00 00 00 00 02 C9 1c 
//VN111                       
39 01 00 00 00 00 02 CA 27 
//VN80                       
39 01 00 00 00 00 02 CB 4c 
//VN52                        
39 01 00 00 00 00 02 CC 0e 
//VN36                        
39 01 00 00 00 00 02 CD 02 
//VN24                        
39 01 00 00 00 00 02 CE 2a 
//VN16                        
39 01 00 00 00 00 02 CF 00 
//VN12                        
39 01 00 00 00 00 02 D0 00  
//VN8                       
39 01 00 00 00 00 02 D1 61 
//VN4                         
39 01 00 00 00 00 02 D2 6F 
//VN0                         
39 01 00 00 00 00 02 D3 39

                     39 00 00 00 00 00 04 ff 98 81 02
                     39 00 00 00 00 00 02 06 20                     
                     39 00 00 00 00 00 02 07 00

										 39 00 00 00 00 00 04 ff 98 81 00
                     39 00 00 00 00 00 03 51 0f ff                     
                     39 00 00 00 00 00 02 53 2c 
                     39 00 00 00 00 00 02 55 01 
                    
		        
		        05 01 00 00 78 00 02 11 00 
		        05 01 00 00 0a 00 02 29 00				
				];				
                qcom,mdss-dsi-on-command-state = "dsi_lp_mode";
                qcom,mdss-dsi-off-command = [
                05 01 00 00 00 00 02 28 00
                05 01 00 00 78 00 02 10 00
                15 01 00 00 00 00 02 4f 01];
                qcom,mdss-dsi-off-command-state = "dsi_hs_mode";
        };
};
