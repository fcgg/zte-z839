/* Copyright (c) 2013, The Linux Foundation. All rights reserved.
 *
 * This program is free software; you can redistribute it and/or modify
 * it under the terms of the GNU General Public License version 2 and
 * only version 2 as published by the Free Software Foundation.
 *
 * This program is distributed in the hope that it will be useful,
 * but WITHOUT ANY WARRANTY; without even the implied warranty of
 * MERCHANTABILITY or FITNESS FOR A PARTICULAR PURPOSE.  See the
 * GNU General Public License for more details.
 */

/*---------------------------------------------------------------------------
 * This file is autogenerated file using gcdb parser. Please do not edit it.
 * Update input XML file to add a new entry or update variable in this file
 * VERSION = "1.0"
 *---------------------------------------------------------------------------*/
&mdss_mdp {
	dsi_lead_hsd_fl80102_fwvga_vid: qcom,zte-lead-fl80102-fwvga-video {
		qcom,mdss-dsi-panel-name = "zteLEAD(FL80102)BOE_480*854_4P5Inch";
		qcom,mdss-pan-physical-height-dimension = <99>;		
		qcom,mdss-pan-physical-width-dimension = <56>;			
		qcom,cont-splash-enabled;
		qcom,mdss-dsi-panel-controller = <&mdss_dsi0>;
		qcom,mdss-dsi-panel-type = "dsi_video_mode";
		qcom,mdss-dsi-panel-destination = "display_1";
		qcom,mdss-dsi-panel-framerate = <60>;
		qcom,mdss-dsi-virtual-channel-id = <0>;
		qcom,mdss-dsi-stream = <0>;
		qcom,mdss-dsi-panel-width = <480>;
		qcom,mdss-dsi-panel-height = <854>;
		qcom,mdss-dsi-h-front-porch = <60>; //zte_tzb modify mipi clk to 385.3MHz, according to maojianfeng, 20160328
		qcom,mdss-dsi-h-back-porch = <60>;
		qcom,mdss-dsi-h-pulse-width = <4>;
		qcom,mdss-dsi-h-sync-skew = <0>;
		qcom,mdss-dsi-v-front-porch = <18>;
		qcom,mdss-dsi-v-pulse-width = <4>;
		qcom,mdss-dsi-v-back-porch = <10>;
		qcom,mdss-dsi-h-left-border = <0>;
		qcom,mdss-dsi-h-right-border = <0>;
		qcom,mdss-dsi-v-top-border = <0>;
		qcom,mdss-dsi-v-bottom-border = <0>;
		qcom,mdss-dsi-bpp = <24>;
		qcom,mdss-dsi-color-order = <0>;
		qcom,mdss-dsi-underflow-color = <0xff>;
		qcom,mdss-dsi-border-color = <0>;
		qcom,mdss-dsi-on-command = [ 
39 01 00 00 00 00  04 B9 F1 08 01 
39 01 00 00 00 00  08 B1 22 1E 1E 87 30 01 8B 
39 01 00 00 00 00  02 b2 22 
39 01 00 00 00 00  09 B3 00 00 06 06 05 05 30 30 
39 01 00 00 00 00  12 BA 31 00 44 25 91 0A 00 00 C1 00 00 00 0D 02 4F B9 EE 
39 01 00 00 00 00  06 E3 04 04 01 01 00 
39 01 00 00 00 00  02 b4 00 
39 01 00 00 00 00  03 b5 05 05 
39 01 00 00 00 00  03 b6 7f 7f //flicker problem
39 01 00 00 00 00  03 b8 64 20 
29 01 00 00 00 00  02 C7 E0          //backlight direction 
29 01 00 00 00 00  03 C8 10 00        //pwm frequency=30kHz 
39 01 00 00 00 00  02 cc 00 
39 01 00 00 00 00  02 bc 47 
39 01 00 00 00 00  34 E9 00 00 06 00 00 81 89 12 31 23 
                                  23 08 81 80 23 00 00 10 00 00 
                                  00 0F 89 13 18 88 88 88 88 88 
                                  88 89 02 08 88 88 88 88 88 88 
                                  00 00 00 00 00 00 00 00 00 00 00 
                                           
39 01 00 00 00 00  17 EA 90 00 00 00 88 02 09 88 88 88 
                                  88 88 88 88 13 19 88 88 88 88 
                                  88 88 
39 01 00 00 00 00  23 E0 00 02 08 15 15 29 2F 3C 0F 13 
                                  12 13 17 15 15 12 18 00 02 08 
                                  15 15 29 2F 3C 0F 13 12 13 17 
                                  15 15 12 18                                                                                           
//39 01 00 00 05 00 02 51 ff  //delete to solve flash screen problem when sleep out
39 01 00 00 05 00 02 53 2c 
//39 01 00 00 05 00 02 55 00 
05 01 00 00 78 00 02 11 00 
05 01 00 00 78 00 02 29 00 
]; 

		qcom,mdss-dsi-off-command = [
					05 01 00 00 78 00 02 10 00];
		qcom,mdss-dsi-on-command-state = "dsi_lp_mode";
		qcom,mdss-dsi-off-command-state = "dsi_hs_mode";
		qcom,mdss-dsi-h-sync-pulse = <1>;
		//qcom,mdss-dsi-traffic-mode = "burst_mode";
		qcom,mdss-dsi-lane-map = "lane_map_0123";
		qcom,mdss-dsi-bllp-eof-power-mode;
		qcom,mdss-dsi-bllp-power-mode;
		qcom,mdss-dsi-lane-0-state;
		qcom,mdss-dsi-lane-1-state;
		/*add for cmd mode start 20140410*/
               qcom,mdss-dsi-te-pin-select = <1>;
               qcom,mdss-dsi-wr-mem-start = <0x2c>;
               qcom,mdss-dsi-te-dcs-command = <1>;
               qcom,mdss-dsi-te-check-enable;
               qcom,mdss-dsi-te-using-te-pin;
               /*add for cmd mode end 20140410*/
		//qcom,mdss-dsi-panel-timings = [6d 18 10 00 3a 3e 12 1a 13 03 04 00];
		//qcom,mdss-dsi-t-clk-post = <0x04>;
		//qcom,mdss-dsi-t-clk-pre = <0x18>;
		qcom,mdss-dsi-panel-timings = [76 18 10 00 3a 3e 14 1c 12 03 04 00];
		qcom,mdss-dsi-t-clk-post = <0x04>;
		qcom,mdss-dsi-t-clk-pre = <0x19>;
		qcom,mdss-dsi-bl-min-level = <1>;
		qcom,mdss-dsi-bl-max-level = <255>;
		qcom,mdss-dsi-dma-trigger = "trigger_sw";
		qcom,mdss-dsi-mdp-trigger = "none";
		//qcom,mdss-dsi-bl-cmd-gpio =  <&msm_gpio 97 0>;
		qcom,mdss-dsi-bl-pmic-control-type = "bl_ctrl_dcs";
		qcom,mdss-dsi-reset-sequence = <1 20>, <0 20>, <1 20>;

	};
};
